## Kconfig
```
# Copyright (c) 2021 Nordic Semiconductor ASA
# SPDX-License-Identifier: Apache-2.0

mainmenu "Bluetooth: Peripheral HT"

config SENSOR
	default y

config TEMP_NRF5
	default y

source "Kconfig.zephyr"
```

## prj.conf
```kconfig
CONFIG_LOG=y
CONFIG_CONSOLE=y
CONFIG_RTT_CONSOLE=y
CONFIG_USE_SEGGER_RTT=y
CONFIG_CBPRINTF_FP_SUPPORT=y
CONFIG_LOG_BUFFER_SIZE=10240
CONFIG_SEGGER_RTT_BUFFER_SIZE_UP=10240

CONFIG_LED=y
CONFIG_GPIO=y
CONFIG_PWM=y
CONFIG_LED_PWM=y

CONFIG_BT=y
CONFIG_BT_SMP=y
CONFIG_BT_PERIPHERAL=y
CONFIG_BT_DIS=y
CONFIG_BT_DIS_PNP=n
CONFIG_BT_DEVICE_NAME="TempSense"
CONFIG_BT_DEVICE_APPEARANCE=768
CONFIG_BT_ATT_ENFORCE_FLOW=n

CONFIG_FLASH=y
CONFIG_FLASH_MAP=y
CONFIG_BOOTLOADER_MCUBOOT=y
CONFIG_ZCBOR=y
CONFIG_MCUMGR=y
CONFIG_MCUMGR_TRANSPORT_BT=y
CONFIG_MCUMGR_TRANSPORT_BT_AUTHEN=n
CONFIG_MCUMGR_TRANSPORT_BT_CONN_PARAM_CONTROL=y
CONFIG_MCUMGR_TRANSPORT_BT_REASSEMBLY=y
CONFIG_MCUMGR_TRANSPORT_NETBUF_SIZE=2475
CONFIG_MCUMGR_GRP_OS_MCUMGR_PARAMS=y
CONFIG_MCUMGR_TRANSPORT_WORKQUEUE_STACK_SIZE=4608
CONFIG_MCUMGR_GRP_ZBASIC=y
CONFIG_MCUMGR_GRP_ZBASIC_STORAGE_ERASE=y
CONFIG_STREAM_FLASH=y
CONFIG_IMG_MANAGER=y
CONFIG_MCUMGR_GRP_IMG=y
CONFIG_MCUMGR_GRP_OS=y
CONFIG_BT_CTLR_LE_PING=n
CONFIG_SYSTEM_WORKQUEUE_STACK_SIZE=2304
```

## app.overlay
```dts
&lsm6dso {
	status = "disabled";
};
```

## src/main.c
```c
/* main.c - Application main entry point */

/*
 * Copyright (c) 2019 Aaron Tsui <aaron.tsui@outlook.com>
 *
 * SPDX-License-Identifier: Apache-2.0
 */

#include <errno.h>
#include <stddef.h>
#include <string.h>
#include <zephyr/bluetooth/bluetooth.h>
#include <zephyr/bluetooth/conn.h>
#include <zephyr/bluetooth/gatt.h>
#include <zephyr/bluetooth/hci.h>
#include <zephyr/bluetooth/services/bas.h>
#include <zephyr/bluetooth/uuid.h>
#include <zephyr/kernel.h>
#include <zephyr/logging/log.h>
#include <zephyr/sys/byteorder.h>
#include <zephyr/sys/printk.h>
#include <zephyr/types.h>

#include "gpio.h"
#include "hts.h"

LOG_MODULE_REGISTER(tempsense, LOG_LEVEL_INF);

#define MIN_ADV_INTERVAL 1999
#define MAX_ADV_INTERVAL 2001
#define ADV_INTERVAL_MULTIPLIER 0.625

static const struct bt_data ad[] = {
	BT_DATA_BYTES(BT_DATA_FLAGS, (BT_LE_AD_GENERAL | BT_LE_AD_NO_BREDR)),
	BT_DATA_BYTES(BT_DATA_UUID16_ALL, BT_UUID_16_ENCODE(BT_UUID_HTS_VAL),
				  BT_UUID_16_ENCODE(BT_UUID_DIS_VAL)),
};

static struct bt_le_adv_param adv_param =
		BT_LE_ADV_PARAM_INIT(BT_LE_ADV_OPT_CONNECTABLE | BT_LE_ADV_OPT_USE_NAME,
							 MIN_ADV_INTERVAL / ADV_INTERVAL_MULTIPLIER,
							 MAX_ADV_INTERVAL / ADV_INTERVAL_MULTIPLIER, NULL);

static void connected(struct bt_conn *conn, uint8_t err)
{
	if (err) {
		LOG_INF("Connection failed (err 0x%02x)", err);
	} else {
		LOG_INF("Connected");
	}
}

static void disconnected(struct bt_conn *conn, uint8_t reason)
{
	LOG_INF("Disconnected (reason 0x%02x)", reason);
}

BT_CONN_CB_DEFINE(conn_callbacks) = {
	.connected = connected,
	.disconnected = disconnected,
};

static void bt_ready(void)
{
	int err;

	LOG_INF("Bluetooth initialized");

	err = bt_le_adv_start(&adv_param, ad, ARRAY_SIZE(ad), NULL, 0);
	if (err) {
		LOG_INF("Advertising failed to start (err %d)", err);
		return;
	}

	LOG_INF("Advertising successfully started");
}

static void auth_cancel(struct bt_conn *conn)
{
	char addr[BT_ADDR_LE_STR_LEN];

	bt_addr_le_to_str(bt_conn_get_dst(conn), addr, sizeof(addr));

	LOG_INF("Pairing cancelled: %s", addr);
}

static struct bt_conn_auth_cb auth_cb_display = {
	.cancel = auth_cancel,
};

int main(void)
{
	int err;

	gpio_init();

	err = bt_enable(NULL);
	if (err) {
		LOG_INF("Bluetooth init failed (err %d)", err);
		return 0;
	}

	bt_ready();

	bt_conn_auth_cb_register(&auth_cb_display);

	/* Implement indicate. At the moment there is no suitable way
	 * of starting delayed work so we do it here
	 */
	while (1) {
		k_sleep(K_SECONDS(1));

		/* Temperature measurements simulation */
		hts_indicate(gpio_get_temp());
	}
	return 0;
}
```

## src/gpio.c
```c
#include <zephyr/drivers/gpio.h>
#include <zephyr/drivers/led.h>
#include <zephyr/drivers/pwm.h>
#include <zephyr/kernel.h>
#include <zephyr/logging/log.h>

#include "gpio.h"

LOG_MODULE_REGISTER(gpio, LOG_LEVEL_INF);

#define BUTTON_NODE DT_NODELABEL(button)
#define POWER_KILL_PIN DT_NODELABEL(power_kill_pin)

#define GREEN_LED_PWM_PCT 100U
#define AMBER_LED_PWM_PCT 30U
#define TEMP_MILD 20U

enum led_colour {
	LED_OFF,
	LED_GREEN,
	LED_AMBER,
};

static void button_pressed(const struct device *dev, struct gpio_callback *cb, uint32_t pins);
static void button_released(const struct device *dev, struct gpio_callback *cb, uint32_t pins);
static void led_timer_timeout_cb(struct k_timer *timer);
static void long_button_press_timeout_cb(struct k_timer *timer);
static void long_button_press_cb(struct k_work *work);

K_TIMER_DEFINE(led_timer, led_timer_timeout_cb, NULL);
K_TIMER_DEFINE(long_button_press_timer, long_button_press_timeout_cb, NULL);
K_WORK_DEFINE(long_button_press_work, long_button_press_cb);

static const struct gpio_dt_spec button_node = GPIO_DT_SPEC_GET(BUTTON_NODE, gpios);
static const struct pwm_dt_spec green_pwm_led = PWM_DT_SPEC_GET(DT_NODELABEL(green_led_pwm));
static const struct pwm_dt_spec amber_pwm_led = PWM_DT_SPEC_GET(DT_NODELABEL(yellow_led_pwm));
static const struct device *pwm_leds_dev = DEVICE_DT_GET(DT_PARENT(DT_NODELABEL(green_led_pwm)));
static const struct device *temp_dev = DEVICE_DT_GET_ANY(nordic_nrf_temp);
static struct gpio_callback button_cb_data;
static const struct gpio_dt_spec pwr_kill_pin = GPIO_DT_SPEC_GET(POWER_KILL_PIN, gpios);

/**************************************************************************************************
 * FUNCTIONS
 **************************************************************************************************/

static uint8_t get_green_led_pwm(void)
{
	return GREEN_LED_PWM_PCT;
}

static uint8_t get_amber_led_pwm(void)
{
	return AMBER_LED_PWM_PCT;
}

static void configure_leds(void)
{
	if (!device_is_ready(pwm_leds_dev)) {
		LOG_ERR("Device %s is not ready", pwm_leds_dev->name);
		return;
	}
	if (!device_is_ready(amber_pwm_led.dev)) {
		LOG_ERR("Device %s is not ready", amber_pwm_led.dev->name);
		return;
	}
	if (!device_is_ready(green_pwm_led.dev)) {
		LOG_ERR("Device %s is not ready", green_pwm_led.dev->name);
		return;
	}
}

static void configure_button_interrupt(void(*button_callback), bool rising_edge)
{
	int ret;
	if (rising_edge) {
		ret = gpio_pin_interrupt_configure_dt(&button_node, GPIO_INT_EDGE_RISING);
	} else {
		ret = gpio_pin_interrupt_configure_dt(&button_node, GPIO_INT_EDGE_FALLING);
	}
	if (ret != 0) {
		LOG_ERR("Error %d: failed to configure interrupt on %s pin %d", ret, button_node.port->name,
				button_node.pin);
		return;
	}
	gpio_init_callback(&button_cb_data, button_callback, BIT(button_node.pin));
	gpio_add_callback(button_node.port, &button_cb_data);
}

static void configure_button(const struct gpio_dt_spec *button)
{
	int ret;
	ret = gpio_pin_configure_dt(button, GPIO_INPUT);
	if (ret != 0) {
		LOG_ERR("Error %d: failed to configure %s pin %d", ret, button->port->name, button->pin);
		return;
	}
	if (!device_is_ready(button->port)) {
		LOG_ERR("Error: button device %s is not ready", button->port->name);
		return;
	}
	/* Wearable button pin is ACTIVE_HIGH */
	configure_button_interrupt(button_pressed, true);
}

void gpio_init(void)
{
	configure_button(&button_node);
	configure_leds();

	if (temp_dev == NULL || !device_is_ready(temp_dev)) {
		LOG_WRN("no temperature device");
	} else {
		LOG_INF("temp device is %p, name is %s", temp_dev, temp_dev->name);
	}
}

int gpio_green_led_on(void)
{
	int err = led_set_brightness(pwm_leds_dev, green_pwm_led.channel, get_green_led_pwm());
	if (err != 0) {
		LOG_ERR("Failed to set green PWM LED brightness to %d PWM.", get_green_led_pwm());
	} else {
		LOG_DBG("Green PWM LED on");
	}
	return err;
}

int gpio_green_led_off(void)
{
	int err = led_off(pwm_leds_dev, green_pwm_led.channel);
	if (err != 0) {
		LOG_ERR("Failed to turn off PWM LED");
	} else {
		LOG_DBG("Green PWM LED off");
	}
	return err;
}

int gpio_amber_led_on(void)
{
	int err = led_set_brightness(pwm_leds_dev, amber_pwm_led.channel, get_amber_led_pwm());
	if (err != 0) {
		LOG_ERR("Failed to set amber PWM LED brightness to %d PWM.", get_amber_led_pwm());
	} else {
		LOG_DBG("Amber PWM LED on");
	}
	return err;
}

int gpio_amber_led_off(void)
{
	int err = led_off(pwm_leds_dev, amber_pwm_led.channel);
	if (err != 0) {
		LOG_ERR("Failed to turn off amber PWM LED");
	} else {
		LOG_DBG("Amber PWM LED off");
	}
	return err;
}

double gpio_get_temp(void)
{
	struct sensor_value temp_value;

	int err = sensor_sample_fetch(temp_dev);
	if (err) {
		LOG_INF("sensor_sample_fetch failed return: %d", err);
	}

	err = sensor_channel_get(temp_dev, SENSOR_CHAN_DIE_TEMP, &temp_value);
	if (err) {
		LOG_INF("sensor_channel_get failed return: %d", err);
	}

	double temp = sensor_value_to_double(&temp_value);
	LOG_INF("temperature is %gC", temp);

	return temp;
}

static void button_pressed(const struct device *dev, struct gpio_callback *cb, uint32_t pins)
{
	LOG_INF("Button pressed");

	if (gpio_get_temp() >= TEMP_MILD) {
		gpio_green_led_on();
	} else {
		gpio_amber_led_on();
	}

	k_timer_start(&long_button_press_timer, K_SECONDS(18), K_NO_WAIT);
	k_timer_start(&led_timer, K_SECONDS(5), K_NO_WAIT);

	configure_button_interrupt(button_released, false);
}

static void button_released(const struct device *dev, struct gpio_callback *cb, uint32_t pins)
{
	k_timer_stop(&long_button_press_timer);

	configure_button_interrupt(button_pressed, true);
}

static void led_timer_timeout_cb(struct k_timer *timer)
{
	(void)gpio_green_led_off();
	(void)gpio_amber_led_off();
}

static void poweroff(void)
{
	LOG_INF("Powering system off");

	int err = gpio_pin_configure_dt(&pwr_kill_pin, GPIO_OUTPUT_ACTIVE);
	if (err != 0) {
		LOG_ERR("Failed to set power kill signal, aborting power off. Error %d", err);
	}
}

static void long_button_press_timeout_cb(struct k_timer *timer)
{
	int err = k_work_submit(&long_button_press_work);
	if (err < 0) {
		LOG_ERR("Failed to submit work of executing long button press event, error %d", err);
	}
}

static void long_button_press_cb(struct k_work *work)
{
	poweroff();
}
```

## src/gpio.h
```c
#ifndef GPIO_H_
#define GPIO_H_

#include <zephyr/drivers/sensor.h>

void gpio_init(void);

int gpio_green_led_on(void);

int gpio_green_led_off(void);

int gpio_amber_led_on(void);

int gpio_amber_led_off(void);

double gpio_get_temp(void);

#endif /* GPIO_H_ */
```

## src/hts.c
```c
/** @file
 *  @brief HTS Service sample
 */

/*
 * Copyright (c) 2020 SixOctets Systems
 * Copyright (c) 2019 Aaron Tsui <aaron.tsui@outlook.com>
 *
 * SPDX-License-Identifier: Apache-2.0
 */

#include <errno.h>
#include <stddef.h>
#include <stdio.h>
#include <string.h>
#include <zephyr/bluetooth/bluetooth.h>
#include <zephyr/bluetooth/conn.h>
#include <zephyr/bluetooth/gatt.h>
#include <zephyr/bluetooth/hci.h>
#include <zephyr/bluetooth/uuid.h>
#include <zephyr/drivers/sensor.h>
#include <zephyr/kernel.h>
#include <zephyr/logging/log.h>
#include <zephyr/sys/byteorder.h>
#include <zephyr/sys/printk.h>

LOG_MODULE_REGISTER(hts, LOG_LEVEL_INF);

static const struct device *temp_dev = DEVICE_DT_GET_ANY(nordic_nrf_temp);

static uint8_t simulate_htm;
static uint8_t indicating;
static struct bt_gatt_indicate_params ind_params;

static void htmc_ccc_cfg_changed(const struct bt_gatt_attr *attr, uint16_t value)
{
	simulate_htm = (value == BT_GATT_CCC_INDICATE) ? 1 : 0;
}

static void indicate_cb(struct bt_conn *conn, struct bt_gatt_indicate_params *params, uint8_t err)
{
	LOG_INF("Indication %s", err != 0U ? "fail" : "success");
}

static void indicate_destroy(struct bt_gatt_indicate_params *params)
{
	LOG_INF("Indication complete");
	indicating = 0U;
}

/* Health Thermometer Service Declaration */
BT_GATT_SERVICE_DEFINE(hts_svc, BT_GATT_PRIMARY_SERVICE(BT_UUID_HTS),
					   BT_GATT_CHARACTERISTIC(BT_UUID_HTS_MEASUREMENT, BT_GATT_CHRC_INDICATE,
											  BT_GATT_PERM_NONE, NULL, NULL, NULL),
					   BT_GATT_CCC(htmc_ccc_cfg_changed, BT_GATT_PERM_READ | BT_GATT_PERM_WRITE),
					   /* more optional Characteristics */
);

void hts_init(void)
{
	if (temp_dev == NULL || !device_is_ready(temp_dev)) {
		LOG_INF("no temperature device; using simulated data");
		temp_dev = NULL;
	} else {
		LOG_INF("temp device is %p, name is %s", temp_dev, temp_dev->name);
	}
}

void hts_indicate(void)
{
	/* Temperature measurements simulation */
	struct sensor_value temp_value;

	if (simulate_htm) {
		static uint8_t htm[5];
		static double temperature = 20U;
		uint32_t mantissa;
		uint8_t exponent;
		int r;

		if (indicating) {
			return;
		}

		if (!temp_dev) {
			temperature++;
			if (temperature == 30U) {
				temperature = 20U;
			}

			goto gatt_indicate;
		}

		r = sensor_sample_fetch(temp_dev);
		if (r) {
			LOG_INF("sensor_sample_fetch failed return: %d", r);
		}

		r = sensor_channel_get(temp_dev, SENSOR_CHAN_DIE_TEMP, &temp_value);
		if (r) {
			LOG_INF("sensor_channel_get failed return: %d", r);
		}

		temperature = sensor_value_to_double(&temp_value);

	gatt_indicate:
		LOG_INF("temperature is %gC", temperature);

		mantissa = (uint32_t)(temperature * 100);
		exponent = (uint8_t)-2;

		htm[0] = 0; /* temperature in celsius */
		sys_put_le24(mantissa, (uint8_t *)&htm[1]);
		htm[4] = exponent;

		ind_params.attr = &hts_svc.attrs[2];
		ind_params.func = indicate_cb;
		ind_params.destroy = indicate_destroy;
		ind_params.data = &htm;
		ind_params.len = sizeof(htm);

		if (bt_gatt_indicate(NULL, &ind_params) == 0) {
			indicating = 1U;
		}
	}
}
```

## src/hts.h
```c
/** @file
 *  @brief HTS Service sample
 */

/*
 * Copyright (c) 2019 Aaron Tsui <aaron.tsui@outlook.com>
 *
 * SPDX-License-Identifier: Apache-2.0
 */

#ifdef __cplusplus
extern "C" {
#endif

void hts_indicate(double temperature);

#ifdef __cplusplus
}
#endif
```
